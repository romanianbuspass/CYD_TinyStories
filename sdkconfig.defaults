## sdkconfig.defaults
```kconfig
# CYD TinyStories - sdkconfig defaults
CONFIG_IDF_TARGET="esp32s3"

# Flash / Partitions
CONFIG_PARTITION_TABLE_CUSTOM=y
CONFIG_PARTITION_TABLE_CUSTOM_FILENAME="partitions.csv"
CONFIG_ESPTOOLPY_FLASHSIZE_16MB=y
CONFIG_ESPTOOLPY_FLASHMODE_QIO=y
CONFIG_ESPTOOLPY_FLASHFREQ_80M=y

# CPU / Performance
CONFIG_ESP32S3_DEFAULT_CPU_FREQ_240=y
CONFIG_FREERTOS_HZ=1000

# PSRAM - Octal, 8MB
CONFIG_SPIRAM=y
CONFIG_SPIRAM_MODE_OCT=y
CONFIG_SPIRAM_SPEED_80M=y
CONFIG_SPIRAM_USE_MALLOC=y
CONFIG_SPIRAM_TYPE_AUTO=y

# ESP-DSP / SIMD
CONFIG_ESP32S3_INSTRUCTION_CACHE_16KB=y
CONFIG_COMPILER_OPTIMIZATION_PERF=y

# LVGL
CONFIG_LV_COLOR_DEPTH_16=y
CONFIG_LV_MEM_SIZE_KILOBYTES=64

# Stack sizes for dual-core tasks
CONFIG_ESP_MAIN_TASK_STACK_SIZE=8192
```
